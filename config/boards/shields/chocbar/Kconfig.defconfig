## config/boards/shields/humla/Kconfig.shield
```kconfig
# Copyright (c) 2022 The ZMK Contributors
# SPDX-License-Identifier: MIT

config SHIELD_HUMLA
    def_bool $(shields_list_contains,humla)

config SHIELD_HUMLA_DONGLE
    def_bool $(shields_list_contains,humla_dongle)
```

## config/boards/shields/satpad/Kconfig.defconfig
```kconfig
# Copyright (c) 2022 The ZMK Contributors
# SPDX-License-Identifier: MIT

if SHIELD_SATPAD

config ZMK_KEYBOARD_NAME
    default "SatPad"

endif
```

## config/boards/shields/satpad/Kconfig.shield
```kconfig
# Copyright (c) 2022 The ZMK Contributors
# SPDX-License-Identifier: MIT

config SHIELD_SATPAD
	def_bool $(shields_list_contains,satpad)
```

## config/west.yml
```yaml
manifest:
  remotes:
    - name: nickconway
      url-base: https://github.com/nickconway
  projects:
    - name: zmk
      remote: nickconway
      revision: dev
      import: app/west.yml
  self:
    path: config
```
